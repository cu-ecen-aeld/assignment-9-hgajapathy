## base_external/package/aesdchar_driver/Config.in
```kconfig
config BR2_PACKAGE_AESDCHAR_DRIVER
	bool "aesdchar_driver"
	help
	  Includes aesdchar character device driver in the kernel image.
	  Used to understand buildroot external trees and package builds.
```

## base_external/package/ldd/Config.in
```kconfig
config BR2_PACKAGE_LDD
	bool "ldd"
	help
	  Linux Device Driver example modules.
	  Used to understand buildroot external trees and package builds.
```
